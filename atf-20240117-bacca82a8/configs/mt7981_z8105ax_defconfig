## uboot-mtk-20250711/board/mediatek/common/customizations/Kconfig
```kconfig
menuconfig MTK_MISC_CUSTOMIZED
	bool "Enable misc customized features support"
	help
	  This option enabled mediatek misc customized features support

if MTK_MISC_CUSTOMIZED

config MTK_COLOR_LED
	bool "Enable color led program (cled)"
	default n
	select PWM_MTK
	select CYCLIC
	help
	  Select this if you want to build mediatek color led program

endif #MTK_MISC_CUSTOMIZED

config ENETLITE_BOOTINFO
	bool "Enable eNetLiteBoot branding and version metadata"
	default n
	help
	  Enable eNetLiteBoot branding, build metadata, Web failsafe version
	  output and OpenWrt-readable FDT /chosen properties.

config ENETLITE_BOOTLOADER_NAME
	string "eNetLiteBoot display name"
	depends on ENETLITE_BOOTINFO
	default "eNetLiteBoot"

config ENETLITE_BOOTLOADER_VERSION
	string "eNetLiteBoot release version"
	depends on ENETLITE_BOOTINFO
	default "eNetLiteBoot v26.06R0"

config ENETLITE_BOOTLOADER_BUILD_ID
	string "eNetLiteBoot build id"
	depends on ENETLITE_BOOTINFO
	default "unknown"
```

## uboot-mtk-20250711/configs/mt7981_z8105ax_per_slot_defconfig
```kconfig
#
# Z8105AX per-slot rootfs_data compatibility alias.
# This file intentionally matches mt7981_z8105ax_defconfig because per-slot
# rootfs_data is the default Z8105AX mode.
#
CONFIG_ARM=y
CONFIG_SYS_HAS_NONCACHED_MEMORY=y
CONFIG_POSITION_INDEPENDENT=y
CONFIG_ARCH_MEDIATEK=y
CONFIG_TEXT_BASE=0x41e00000
CONFIG_SYS_MALLOC_F_LEN=0x4000
CONFIG_NR_DRAM_BANKS=1
CONFIG_ENV_SIZE=0x20000
CONFIG_ENV_OFFSET=0x0
CONFIG_DEFAULT_DEVICE_TREE="mt7981-z8105ax"
CONFIG_TARGET_MT7981=y
CONFIG_LOCALVERSION="-eNetLiteBoot-v26.06R0"
# CONFIG_LOCALVERSION_AUTO is not set
CONFIG_IDENT_STRING=" eNetLiteBoot"
CONFIG_DEBUG_UART_BASE=0x11002000
CONFIG_DEBUG_UART_CLOCK=40000000
CONFIG_SYS_LOAD_ADDR=0x46000000
CONFIG_PCI=y
CONFIG_DEBUG_UART=y
CONFIG_MEDIATEK_BOOTMENU=y
CONFIG_MTK_WEB_FAILSAFE=y
CONFIG_MTK_WEB_FAILSAFE_AFTER_BOOT_FAILURE=y
CONFIG_MTK_UBI_SUPPORT=y
CONFIG_MTK_UPGRADE_BL2_VERIFY=y
CONFIG_MTK_UPGRADE_FIP_VERIFY=y
CONFIG_ENABLE_NAND_NMBM=y
CONFIG_AUTOBOOT_MENU_SHOW=y
CONFIG_AUTOBOOT_MENU_MTK_SHOW=y
CONFIG_DEFAULT_FDT_FILE="mt7981-z8105ax"
CONFIG_SYS_CBSIZE=512
CONFIG_SYS_PBSIZE=1049
CONFIG_LOGLEVEL=7
CONFIG_LOG=y
CONFIG_SYS_PROMPT="MT7981> "
# CONFIG_BOOTM_NETBSD is not set
# CONFIG_BOOTM_PLAN9 is not set
# CONFIG_BOOTM_RTEMS is not set
# CONFIG_BOOTM_VXWORKS is not set
# CONFIG_CMD_ELF is not set
# CONFIG_CMD_XIMG is not set
# CONFIG_CMD_UNLZ4 is not set
# CONFIG_CMD_UNZIP is not set
CONFIG_CMD_GPIO=y
CONFIG_CMD_PWM=y
CONFIG_CMD_I2C=y
CONFIG_CMD_MTD=y
CONFIG_CMD_NMBM=y
CONFIG_CMD_PCI=y
CONFIG_CMD_PING=y
CONFIG_CMD_SMC=y
CONFIG_MTDIDS_DEFAULT="nmbm0=nmbm0"
CONFIG_MTDPARTS_DEFAULT="nmbm0:1024k(bl2),512k(u-boot-env),2048k(factory),2048k(fip),-(ubi)"
CONFIG_ENV_OVERWRITE=y
CONFIG_ENV_IS_IN_MTD=y
CONFIG_ENV_MTD_DEV="u-boot-env"
CONFIG_ENV_VARS_UBOOT_RUNTIME_CONFIG=y
CONFIG_NET_RANDOM_ETHADDR=y
CONFIG_USE_IPADDR=y
CONFIG_IPADDR="192.168.21.1"
CONFIG_USE_NETMASK=y
CONFIG_NETMASK="255.255.255.0"
CONFIG_USE_SERVERIP=y
CONFIG_SERVERIP="192.168.21.2"
CONFIG_NET_FORCE_IPADDR=y
CONFIG_PROT_TCP=y
CONFIG_MTK_DUAL_BOOT=y
CONFIG_MTK_DUAL_BOOT_ITB_IMAGE=y
CONFIG_ENETLITE_AB_MAX_TRIES=3
CONFIG_MTK_DUAL_BOOT_SLOT_1_FIRMWARE_NAME="firmware2"
CONFIG_MTK_DUAL_BOOT_SLOT_1_ROOTFS_DATA_NAME="rootfs_data2"
CONFIG_FIT=y
# CONFIG_MTK_UPGRADE_IMAGE_VERIFY is not set
# CONFIG_MTK_UPGRADE_IMAGE_ROOTFS_VERIFY is not set
CONFIG_REGMAP=y
CONFIG_SYSCON=y
CONFIG_CLK=y
CONFIG_DM_I2C=y
CONFIG_I2C_SET_DEFAULT_BUS_NUM=y
CONFIG_SYS_I2C_MTK=y
# CONFIG_MMC is not set
CONFIG_DM_MTD=y
CONFIG_MTD_SPI_NAND=y
CONFIG_PHY_FIXED=y
CONFIG_MEDIATEK_ETH=y
CONFIG_PCIE_MEDIATEK=y
CONFIG_PINCTRL=y
CONFIG_PINCONF=y
CONFIG_PINCTRL_MT7981=y
CONFIG_POWER_DOMAIN=y
CONFIG_MTK_POWER_DOMAIN=y
CONFIG_DM_PWM=y
CONFIG_PWM_MTK=y
CONFIG_DM_SERIAL=y
CONFIG_MTK_SERIAL=y
CONFIG_SPI=y
CONFIG_DM_SPI=y
CONFIG_MTK_SPIM=y
CONFIG_HEXDUMP=y
CONFIG_DM_GPIO=y
CONFIG_BUTTON=y
CONFIG_BUTTON_GPIO=y
CONFIG_LED=y
CONFIG_LED_GPIO=y
CONFIG_CMD_BUTTON=y
CONFIG_CMD_LED=y
CONFIG_CMD_GL_BTN=y
CONFIG_CMD_WPS_SLOT_SWITCH=y
CONFIG_ENETLITE_BOOTINFO=y
CONFIG_ENETLITE_BOOTLOADER_NAME="eNetLiteBoot"
CONFIG_ENETLITE_BOOTLOADER_VERSION="eNetLiteBoot v26.06R0"
# CONFIG_EFI_LOADER is not set
```
